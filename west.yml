## west.yml
```yaml
manifest:
  # lowest version of the manifest file schema that can parse this file’s data
  version: 0.8

  self:
    path: app

  projects:
   # example for an "project" that is sourced from another repository and managed by west.
    - name: doxygen-awesome
      url: https://github.com/jothepro/doxygen-awesome-css
      # you can also use SSH instead of HTTPS:
      # url: git@github.com:jothepro/doxygen-awesome-css.git
      revision: v2.2.1
      # if you want to have the latest changes, e.g., during development,
      # specify the corresponding branch in the revision:
      # revision: main
      path: deps/utilities/doxygen-awesome-css
```
